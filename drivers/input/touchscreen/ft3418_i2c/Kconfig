## drivers/input/touchscreen/ft3418_i2c/Kconfig
```kconfig
#
# Focaltech Touchscreen driver configuration
#

config TOUCHSCREEN_FTS
	bool "Focaltech Touchscreen"
	depends on DRM
	default n
	help
	  Say Y here if you have Focaltech touch panel.
	  If unsure, say N.
      
config TOUCHSCREEN_FTS_DIRECTORY
	string "Focaltech ts directory name"
	default "ft3418_i2c"
	depends on TOUCHSCREEN_FTS
```
